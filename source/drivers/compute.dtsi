/* Merge into the matching candidate device tree only; no installation this round. */
/ {
    pcb_ai@43c40000 { compatible = "pcb,ai-1"; reg = <0x43c40000 0x40000>; clocks = <&clkc 16>; clock-names = "aclk"; };
    pcb_adc@43c80000 { compatible = "pcb,adc-1"; reg = <0x43c80000 0x20000>; clocks = <&clkc 16>; clock-names = "aclk"; };
};
